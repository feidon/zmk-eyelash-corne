## config/west.yml
```yaml
manifest:
  remotes:
    - name: zmkfirmware
      url-base: https://github.com/zmkfirmware
    - name: m165437
      url-base: https://github.com/M165437
    - name: englmaxi
      url-base: https://github.com/englmaxi
  projects:
    - name: eyelash_corne
      url: https://github.com/a741725193/zmk-new_corne
      revision: main
    - name: zmk
      remote: zmkfirmware
      revision: v0.3.0
      import: app/west.yml
    - name: nice-view-gem
      remote: m165437
      revision: v0.3.0
    - name: zmk-dongle-display
      remote: englmaxi
      revision: v0.3
  self:
    path: config
```
